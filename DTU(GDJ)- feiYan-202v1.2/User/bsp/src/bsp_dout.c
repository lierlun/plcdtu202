#include "bsp.h"

/*
*********************************************************************************************************
*	函 数 名: bsp_InitDout
*	功能说明: 配置输出IO
*	形    参: 无
*	返 回 值: 无
*********************************************************************************************************
*/
void bsp_InitDout(void)
{
	GPIO_InitTypeDef GPIO_InitStructure;

	/* 打开GPIO时钟 */
	RCC_APB2PeriphClockCmd(RCC_ALL_DOUT, ENABLE);
	
	GPIO_InitStructure.GPIO_Speed = GPIO_Speed_50MHz;
	GPIO_InitStructure.GPIO_Mode  = GPIO_Mode_Out_PP;	/* 推挽输出模式 */
	
	GPIO_InitStructure.GPIO_Pin   = GPIO_PIN_DOUT1;
	GPIO_Init(GPIO_PORT_DOUT1, &GPIO_InitStructure);
}

/*
*********************************************************************************************************
*	函 数 名: bsp_DoutOn
*	功能说明: 输出打开
*	形    参:  _no : 序号，范围 1
*	返 回 值: 无
*********************************************************************************************************
*/
void bsp_DoutOn(uint8_t _no)
{
	_no--;

	if (_no == 0)
	{
		GPIO_PORT_DOUT1->BSRR = GPIO_PIN_DOUT1;
	}
}

/*
*********************************************************************************************************
*	函 数 名: bsp_DoutOff
*	功能说明: 输出关闭
*	形    参:  _no : 序号，范围 1
*	返 回 值: 无
*********************************************************************************************************
*/
void bsp_DoutOff(uint8_t _no)
{
	_no--;

	if (_no == 0)
	{
		GPIO_PORT_DOUT1->BRR = GPIO_PIN_DOUT1;
	}
}

/*
*********************************************************************************************************
*	函 数 名: bsp_DoutToggle
*	功能说明: 翻转IO
*	形    参:  _no : 序号，范围 1
*	返 回 值: 无
*********************************************************************************************************
*/
void bsp_DoutToggle(uint8_t _no)
{
	if (_no == 1)
	{
		GPIO_PORT_DOUT1->ODR ^= GPIO_PIN_DOUT1;
	}
}

/*
*********************************************************************************************************
*	函 数 名: bsp_IsDoutOn
*	功能说明: 判断输出是否打开
*	形    参:  _no : 序号，范围 1
*	返 回 值: 1表示已经点亮，0表示未点亮
*********************************************************************************************************
*/
uint8_t bsp_IsDoutOn(uint8_t _no)
{
	if (_no == 1)
	{
		if ((GPIO_PORT_LED1->ODR & GPIO_PIN_LED1) == 0)
		{
			return 1;
		}
		return 0;
	}
	return 0;
}
